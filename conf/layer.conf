## conf/layer.conf
```bitbake
# We have a conf and classes directory, add to BBPATH
BBPATH .= ":${LAYERDIR}"

# We have recipes-* directories, add to BBFILES
BBFILES += "${LAYERDIR}/recipes-*/*/*.bb \
            ${LAYERDIR}/recipes-*/*/*.bbappend"

BBFILE_COLLECTIONS += "meta-kai"
BBFILE_PATTERN_meta-kai = "^${LAYERDIR}/"
BBFILE_PRIORITY_meta-kai = "6"

LAYERDEPENDS_meta-kai = "core"
LAYERSERIES_COMPAT_meta-kai = "scarthgap"
```
